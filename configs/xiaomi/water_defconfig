## configs/xiaomi/water_defconfig
```kconfig
CONFIG_BOOTLOADER_BASE=0x48000000
CONFIG_BOOTLOADER_SIZE=0x1388A4
CONFIG_BOOTMODE_ADDRESS=0x4813B5D0
CONFIG_CERT_BYPASS=y
CONFIG_PLATFORM_INIT_CALLER=0x48020278
CONFIG_PLATFORM_INIT_ADDRESS=0x48002C68
CONFIG_APP_ADDRESS=0x48024F3C
CONFIG_VIDEO_PRINTF_ADDRESS=0x48027BF0
CONFIG_FASTBOOT_FAIL_ADDRESS=0x48025BD8
CONFIG_FASTBOOT_INFO_ADDRESS=0x48025A38
CONFIG_FASTBOOT_OKAY_ADDRESS=0x48025DB8
CONFIG_FASTBOOT_PUBLISH_ADDRESS=0x480256C4
CONFIG_FASTBOOT_REGISTER_ADDRESS=0x48025688
CONFIG_LK_LOG_STORE_ADDRESS=0x48047FBC
CONFIG_INIT_STORAGE_CALLER=0x48002C98
CONFIG_INIT_STORAGE_ADDRESS=0x48002A1C
CONFIG_MALLOC_ADDRESS=0x48035B20
CONFIG_DPRINTF_ADDRESS=0x48034EA8
CONFIG_FREE_ADDRESS=0x480352D8
CONFIG_PARTITION_READ_ADDRESS=0x48050724
CONFIG_PARTITION_GET_SIZE_BY_NAME_ADDRESS=0x4804EC60
CONFIG_XIAOMI_WATER=y
CONFIG_MEDIATEK_MT6765=y
```
